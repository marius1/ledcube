#include "global.h"

#include <stdio.h>
#include <string.h>
#include <stdlib.h>

#include <avr/io.h>		// include I/O definitions (port names, pin names, etc)
#include <avr/interrupt.h>
#include <avr/pgmspace.h>
#include <util/delay.h>

#include "uart/uart.h"

#define CLK_PIN 		PD5
#define CLK_PORT 		PORTD
#define CLK_DDR 		DDRD

#define DATA_PIN 		PD7
#define DATA_PORT 		PORTD
#define DATA_DDR 		DDRD

#define LATCH_PIN		PD6
#define LATCH_PORT 		PORTD
#define LATCH_DDR 		DDRD

#define LEVEL0_PIN		PC3
#define LEVEL1_PIN		PC2
#define LEVEL2_PIN		PC5
#define LEVEL3_PIN		PC4
#define LEVEL_PORT		PORTC
#define LEVEL_DDR		DDRC

#define latch_high()	LATCH_PORT |= ( 1 << PD6 )
#define latch_low()		LATCH_PORT &= ~( 1 << PD6 )

#define clk_high()		CLK_PORT |= ( 1 << PD5 )
#define clk_low()		CLK_PORT &= ~( 1 << PD5 )

#define data_high()		DATA_PORT |= ( 1 << PD7 )
#define data_low()		DATA_PORT &= ~( 1 << PD7 )

#define STATUS_LED_PIN 		PB0
#define STATUS_LED_PORT 	PORTB
#define STATUS_LED_DDR 		DDRB

/* red status led */
#define status_led_init() 	(STATUS_LED_DDR    |=  (1 << STATUS_LED_PIN))
#define status_led_on() 	(STATUS_LED_PORT   |=  (1 << STATUS_LED_PIN))
#define status_led_off() 	(STATUS_LED_PORT   &= ~(1 << STATUS_LED_PIN)) 

void setLedXYZ( uint8_t x, uint8_t y, uint8_t z );
void toggleLevel( uint8_t level );
void pins_init();
void shiftOut(uint8_t val);
void setLed( uint8_t position );
void setLedXYZ( uint8_t x, uint8_t y, uint8_t z );

void setLed( uint8_t position )
{
	//    z y x dec hex
	// 00010101	21  15
	//    1 1 1 
	// 00010100 20  14
	//    1 1 0
	// 00100001 33  21 
	//    2 0 1
	// 00110101 53  35
	//    3 1 1	
	
	// get y, x, z from the position byte
	uint8_t x = 3 & position;
	uint8_t y = (12 & position) >> 2;
	uint8_t z = (48 & position) >> 4;
	
	setLedXYZ( x, y, z);
}

void setLedXYZ( uint8_t x, uint8_t y, uint8_t z )
{
	// convert x to correct scale: 2^(x*4)
	uint16_t x1 = (1 << (x * 4));
	// convert y to correct scale: 2^x
	uint16_t y1 = (1 << y);
	
	// calculate shiftregiter value
	uint16_t val = x1 * y1;
	
	// shift value into registers
	latch_low();
	shiftOut( (val >> 8) );
	shiftOut( val );
	latch_high();
	
	// enable z
	toggleLevel(z);	
}

uint32_t pos = 0;
uint16_t timeout = 0;
uint8_t num_leds = 0;

uint8_t anim[] = { 
		// proto:
		// num leds in frame, timout1, timeout2, led 1, led n		
		0x10, 0x00, 0x64, 0x00, 0x01, 0x02, 0x03, 0x10, 0x11, 0x12, 0x13, 0x20, 0x21, 0x22, 0x23, 0x30, 0x31, 0x32, 0x33,
		0x10, 0x00, 0x64, 0x04, 0x05, 0x06, 0x07, 0x14, 0x15, 0x16, 0x17, 0x24, 0x25, 0x26, 0x27, 0x34, 0x35, 0x36, 0x37,
		0x10, 0x00, 0x64, 0x08, 0x09, 0x0a, 0x0b, 0x18, 0x19, 0x1a, 0x1b, 0x28, 0x29, 0x2a, 0x2b, 0x38, 0x39, 0x3a, 0x3b,
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		0x10, 0x00, 0x64, 0x30, 0x31, 0x32, 0x33, 0x20, 0x21, 0x22, 0x23, 0x10, 0x11, 0x12, 0x13, 0x03, 0x02, 0x01, 0x00, 
	};
/*
uint8_t frame[125];
uint8_t buffer[125];
uint8_t c;
uint16_t getpos = 0;*/
	
ISR(TIMER1_COMPA_vect)
{
	// check if we should start new frame
	if ( timeout == 0 ) {
		// set new position in array
		pos = pos + num_leds;
		if ( pos >= sizeof(anim) ) {
			pos = 0;
		}
		
		// read new num leds
		num_leds = anim[pos];
		// set new timeout
		timeout = (anim[pos+1] << 4) + anim[pos+2];
		pos += 3;
	}
	
	timeout--;
}

int main(void)
{
	status_led_init();		

	uart_init();
	pins_init();
	uart_puts_p(PSTR("Init done!\n"));
	
	// 16000000 / 64 (CS11 && CS10 ) = 250000 -> 1/250000 = 0,00004s -> 1/0,004ms = 250
	TCCR1B = (1<<WGM12) | (1<<CS11) | (1<<CS10);
	// once every 1ms
	OCR1A = 250;
	
	//Enable the Output Compare A interrupt
	TIMSK |= (1<<OCIE1A);
	//Enable interrupts globally
	sei();
	
	// initialize buffer and frame
	//memset(buffer, 0xff, 125 );
	//memset(frame, 0xff, 125 );

	uint32_t i;

	toggleLevel(3);
		
	while(1) {
		status_led_on();
		
		/*for(j=0;j<16;j++)
		{
			val = (1 << j);
			latch_low();
			shiftOut( (val >> 8 ));
			shiftOut( val );
			latch_high();
		}*/
				
		for( i = pos; i < pos + num_leds; i++ ) {
			setLed(anim[i]);			
		}
		
		/*for( i = 0; i < sizeof(frame); i++ ) {
			if ( 0xff == frame[i] ) 
				break;
			
			setLed(frame[i]);
		}
		
		if((UCSRA & (1 << RXC))) {
			c = uart_getc();
			
			// last byte in frame data
			if ( c == 0xff ) {
				memcpy(frame, buffer, sizeof(buffer));
				memset(buffer, 0xff, 125 );
				getpos = 0;
				
				continue;
			}
			
			buffer[getpos] = c;
			getpos++;
		}*/
		
		status_led_off();
	}
	
	return 0;
}

void toggleLevel( uint8_t level ) {
	
	LEVEL_PORT &= ~(1<<LEVEL0_PIN);
	LEVEL_PORT &= ~(1<<LEVEL1_PIN);
	LEVEL_PORT &= ~(1<<LEVEL2_PIN);
	LEVEL_PORT &= ~(1<<LEVEL3_PIN);
	
	switch(level) {
		case 0:
			LEVEL_PORT |= (1<<LEVEL0_PIN);
			break;
		case 1:
			LEVEL_PORT |= (1<<LEVEL1_PIN);
			break;
		case 2:
			LEVEL_PORT |= (1<<LEVEL2_PIN);
			break;
		case 3:
			LEVEL_PORT |= (1<<LEVEL3_PIN);
			break;
	}
}

void pins_init()
{
	CLK_DDR		|= (1 << CLK_PIN);
	LATCH_DDR 	|= (1 << LATCH_PIN);	
	DATA_DDR 	|= (1 << DATA_PIN);	
	LEVEL_DDR 	|= (1 << LEVEL0_PIN) | (1 << LEVEL1_PIN) | (1 << LEVEL2_PIN) | (1 << LEVEL3_PIN);
}

void shiftOut(uint8_t val)
{
	int i;
	
	for(i = 0; i < 8; i++ ) {
		uint8_t d = !!(val & (1 << (7 - i)));
		
		if ( d == 1 )
			data_high();
		else
			data_low();
		
		clk_high();
		clk_low();
	}
}

